#include <behaviors.dtsi>
#include <dt-bindings/zmk/keys.h>
#include <dt-bindings/zmk/bt.h>

/ {
    keymap {
        compatible = "zmk, keymap";

        default_layer {
            bindings = <
                &none   &kp KP_Q    &kp KP_W    &kp KP_E    &kp KP_R    &kp KP_T
                &kp KP_Q    &kp KP_W    &kp KP_E    &kp KP_R    &kp KP_T
                &none   &kp KP_Q    &kp KP_W    &kp KP_E    &kp KP_R    &kp KP_T
                &kp KP_Q    &kp KP_W    &kp KP_E
                >;
            };
    };
};